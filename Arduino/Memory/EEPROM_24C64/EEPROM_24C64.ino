/*  Author  - Ankur Maurya
    Created - 24 April 2021

    Program for Reading/Writing to EEPROM Memory (24C64)
    65536 bits = 8 KB of Memory Space
    Pages - 256
    Per Page - 32 bytes

    NOTE: Use 10 KOhm Pull-up resistors for both SDA and SCL data lines

    NOTE: The Arduino Wire library only has a 32 character buffer, so that is the maximun we can send using Arduino.
          This buffer includes the two address bytes which limits our data payload to 30 bytes

*/

#include <Wire.h>


const byte fileData[] PROGMEM  = {0x3D, 0x3D, 0x3D, 0x3D, 0x3D, 0x3D, 0x3D, 0x3D, 0x3D, 0x3D, 0x3D, 0x3D, 0x3D, 0x3D, 0x3D, 0x3D,
                                  0x3D, 0x3D, 0x3D, 0x3D, 0x3D, 0x3D, 0x3D, 0x3D, 0x0A, 0x42, 0x55, 0x49, 0x4C, 0x44, 0x20, 0x4F,
                                  0x55, 0x54, 0x50, 0x55, 0x54, 0x20, 0x44, 0x45, 0x53, 0x43, 0x52, 0x49, 0x50, 0x54, 0x49, 0x4F,
                                  0x4E, 0x0A, 0x3D, 0x3D, 0x3D, 0x3D, 0x3D, 0x3D, 0x3D, 0x3D, 0x3D, 0x3D, 0x3D, 0x3D, 0x3D, 0x3D,
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                                  0x73, 0x73, 0x20, 0x65, 0x6C, 0x65, 0x6D, 0x65, 0x6E, 0x74, 0x2E, 0x0D, 0x0A
                                 };


#define EEPROM1_ADDRESS 0x54  //Address of 24C64 eeprom chip is 1010100
#define MEMORY_SIZE 8192     // 8 KB Memory
#define PAGE_SIZE 32     // 32 Bytes
#define SAFE_BUFFER_SIZE 16     // 16 Bytes
#define MEMORY_PAGES 256     // 256 Pages


void writeByte(int deviceAddress, uint16_t memoryAddress, byte data) {
  Wire.beginTransmission(deviceAddress);
  //Write 2 Byte Memory Address
  Wire.write((memoryAddress >> 8)); // MSB
  Wire.write((memoryAddress & 0xFF)); // LSB
  Wire.write(data); //Write the data
  Wire.endTransmission(); //Send stop condition
  delay(20);
}

void writePage(int deviceAddress, uint16_t memoryAddress, byte data[]) {
  /*
     The Arduino Wire library only has a 32 character buffer, so that is the maximun we can send using Arduino.
     This buffer includes the two address bytes which limits our data payload to 30 bytes.
     So here the Page write is divided in batch of 16 bytes write
  */
  byte bufferCounter = 0;

  Serial.print("Writing to Memory Addrress - ");
  Serial.println(memoryAddress, DEC);

  for (int i = 0; i < PAGE_SIZE/SAFE_BUFFER_SIZE; i++) {
    Wire.beginTransmission(deviceAddress);
    //Write 2 Byte Memory Address
    Wire.write((memoryAddress >> 8)); // MSB
    Wire.write((memoryAddress & 0xFF)); // LSB
    for (int i = 0; i < SAFE_BUFFER_SIZE; i++) {
      Wire.write(data[bufferCounter]); //Write the data
      bufferCounter++;
    }
    Wire.endTransmission(); //Send stop condition
    delay(30);

    memoryAddress += SAFE_BUFFER_SIZE;
  }

  Serial.println("Done");
}

byte readByte(int deviceAddress, uint16_t memoryAddress) {
  byte rdata = 0xFF;

  Wire.beginTransmission(deviceAddress);
  //Write 2 Byte Memory Address
  Wire.write((memoryAddress >> 8));   // MSB
  Wire.write((memoryAddress & 0xFF)); // LSB
  Wire.endTransmission();

  Wire.requestFrom(deviceAddress, 1);
  delay(10);

  if (Wire.available())
    rdata = Wire.read();
  return rdata;
}

boolean verifyDataInPage(int deviceAddress, uint16_t pageOffset, byte dataToVerify[]) {
  byte rdata = 0xFF;
  byte pageBuffer[PAGE_SIZE];

  Wire.beginTransmission(deviceAddress);
  //Write 2 Byte Memory Address
  Wire.write((pageOffset >> 8));   // MSB
  Wire.write((pageOffset & 0xFF)); // LSB
  Wire.endTransmission();

  Wire.requestFrom(deviceAddress, PAGE_SIZE);
  delay(10);

  int dataCounter = 0;
  while (Wire.available()) {
    pageBuffer[dataCounter] = Wire.read();
    dataCounter++;
  }

  for (int i = 0; i < PAGE_SIZE; i++) {
    if (pageBuffer[i] != dataToVerify[i]) {
      return false;
    }
  }
  return true;
}

void printAllMemoryPages(int deviceAddress) {
  //Print Data
  for (uint16_t i = 0; i < MEMORY_SIZE; i++) {
    Serial.write(readByte(deviceAddress, i)); //Print statement
  }

  //  int lineCntr = 0;
  //  for (uint16_t i = 0; i < MEMORY_SIZE; i++) {
  //    if (lineCntr == 8) {
  //      Serial.println("");
  //      lineCntr = 0;
  //    }
  //
  //    Serial.print(readByte(EEPROM1_ADDRESS, i), BIN); //Print statement
  //    Serial.print(" ");
  //    lineCntr++;
  //  }
  //  Serial.println("");
}

boolean verifyDataAtMemAddress(int deviceAddress, uint16_t memoryAddress, byte dataToVerify) {
  if (readByte(deviceAddress, memoryAddress) == dataToVerify) {
    return true;
  } else {
    return false;
  }
}

boolean saveToMemoryByBytes(int deviceAddress) {
  boolean allWriteVerifiedSuccess = true;
  uint16_t memoryAddress = 0;

  Serial.print("Writing Data to Memory - ");
  const int dataLen = sizeof(fileData) / sizeof(fileData[0]);
  Serial.print(dataLen, DEC);
  Serial.println(" bytes.");

  long i;
  for (i = 0; i < dataLen; i++) {
    writeByte(deviceAddress, memoryAddress, pgm_read_byte_near(fileData + i)); //Write data to memory
    //Verify data written at memory location
    if (!verifyDataAtMemAddress(deviceAddress, memoryAddress, pgm_read_byte_near(fileData + i))) {
      allWriteVerifiedSuccess = false;
    }
    memoryAddress++;
  }
  Serial.println("Data Written to Memory.");

  return allWriteVerifiedSuccess;
}

boolean saveToMemoryByPages(int deviceAddress) {
  boolean allWriteVerifiedSuccess = true;
  uint16_t pageCounter = 0;
  uint16_t memoryAddress = 0;
  byte pageBuffer[PAGE_SIZE];
  uint16_t bufferCounter = 0;
  byte data = 0;

  Serial.print("Writing Data to Memory - ");
  const int dataLen = MEMORY_SIZE; //sizeof(fileData) / sizeof(fileData[0]);
  Serial.print(dataLen, DEC);
  Serial.println(" bytes.");

  long i;
  for (i = 0; i < dataLen; i++) {
    if (bufferCounter == PAGE_SIZE) {
      pageCounter++;
      Serial.print("Writing to Page - ");
      Serial.println(pageCounter, DEC);
      writePage(deviceAddress, memoryAddress, pageBuffer); //Write data buffer to memory page
      //Verify data written to memory page
      if (!verifyDataInPage(deviceAddress, memoryAddress, pageBuffer)) {
        allWriteVerifiedSuccess = false;
        Serial.println("Verify Failed.");
      }
      bufferCounter = 0;
      memoryAddress = memoryAddress + PAGE_SIZE;
      data++;
    }
    pageBuffer[bufferCounter] = data; //pgm_read_byte_near(fileData + i);
    bufferCounter++;
  }

  if (bufferCounter > 0) {
    //Fill remaining page buffer with constant
    for (uint16_t j = bufferCounter; j < PAGE_SIZE; j++) {
      pageBuffer[bufferCounter] = 45;
      bufferCounter++;
    }

    if (bufferCounter == PAGE_SIZE) {
      pageCounter++;
      Serial.print("Writing to Page - ");
      Serial.println(pageCounter, DEC);
      writePage(deviceAddress, memoryAddress, pageBuffer); //Write data buffer to memory page
      //Verify data written to memory page
      if (!verifyDataInPage(deviceAddress, memoryAddress, pageBuffer)) {
        allWriteVerifiedSuccess = false;
        Serial.println("Verify Failed.");
      }
    }
  }
  Serial.println("Data Written to Memory.");

  return allWriteVerifiedSuccess;
}


void setup(void) {
  Wire.begin();

  Serial.begin(19200);
  while (!Serial) {
    ; // wait for serial port to connect. Needed for native USB
  }

  delay(30000);

  //    byte data = 38;
  //    uint16_t memoryAddress = 1340;
  //    Serial.print("Writing Data : ");
  //    writeByte(EEPROM1_ADDRESS, 1342, data);
  //    Serial.println(data, DEC);
  //
  //    Serial.print("Reading Data : ");
  //    Serial.println(readByte(EEPROM1_ADDRESS, memoryAddress), DEC);

  //  boolean dataWritten = saveToMemoryByBytes(EEPROM1_ADDRESS);
  //  if (dataWritten) {
  //    Serial.println("Data Write to Memory - Success");
  //  } else {
  //    Serial.println("Data Write to Memory - Failed");
  //  }saveToMemoryByPages
  //
  //  boolean dataWritten = saveToMemoryByPages(EEPROM1_ADDRESS);
  //  if (dataWritten) {
  //    Serial.println("Data Write to Memory - Success");
  //  } else {
  //    Serial.println("Data Write to Memory - Failed");
  //  }

  printAllMemoryPages(EEPROM1_ADDRESS);



}




void loop() {}
